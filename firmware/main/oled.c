// SSD1306 128x64 I²C OLED driver — esp_lcd_panel_ssd1306 + a tiny 6x8 font.
//
// Two panels supported, each on its own I²C bus (v2, ESP32-S3-DevKitC-1):
//   MAIN — SDA=GPIO 7,  SCL=GPIO 15, addr 0x3C, I²C bus auto-allocated
//   FACE — SDA=GPIO 16, SCL=GPIO 17, addr 0x3C, I²C bus auto-allocated
// Same chip on both, so they share the SSD1306 panel-init flow. The bus
// init is the only part that's per-panel (different pins / different IDF
// i2c_master handles).
//
// v1 (WROOM-32) used MAIN=21/22. GPIO 22 doesn't exist on the S3 package
// (chip GPIOs are 0-21, 26-48), so the status OLED moves. FACE stays at
// 16/17 — both pins exist on the S3 and the face panel's external wiring
// is preserved. v1 pin map is at git tag `pre-esp32-s3-port`.

#include "oled.h"
#include "app_state.h"

#include <string.h>
#include "esp_log.h"
#include "driver/i2c_master.h"
#include "esp_lcd_panel_io.h"
#include "esp_lcd_panel_ops.h"
#include "esp_lcd_panel_vendor.h"
#include "esp_lcd_panel_ssd1306.h"

static const char *TAG = "oled";

#define MAIN_SDA_GPIO        7
#define MAIN_SCL_GPIO        15
#define FACE_SDA_GPIO        16
#define FACE_SCL_GPIO        17
#define OLED_I2C_ADDR        0x3C
#define OLED_I2C_FREQ_HZ     400000

// Per-panel state. The two OLEDs are mechanically identical, but each gets
// its own I²C bus handle, panel handle, and framebuffer.
typedef struct {
    i2c_master_bus_handle_t bus;
    esp_lcd_panel_io_handle_t io;
    esp_lcd_panel_handle_t panel;
    uint8_t fb[OLED_FB_BYTES];
    bool initialized;
} oled_state_t;

static oled_state_t s_main = {0};
static oled_state_t s_face = {0};

// 6x8 ASCII font, columns are LSB-on-top. 95 chars (0x20..0x7E), 6 bytes each.
// Public-domain glyphs derived from the classic IBM CGA 8x8 font, trimmed to
// 5+1 columns. Only the chars we need at M1/M2 are filled in (status text,
// digits, IP-address dots, hex). Everything else falls back to a small dot
// pattern so we can still tell something rendered.
static const uint8_t font6x8[95][6] = {
    {0x00,0x00,0x00,0x00,0x00,0x00}, // 0x20 ' '
    {0x00,0x00,0x5F,0x00,0x00,0x00}, // 0x21 '!'
    {0x00,0x07,0x00,0x07,0x00,0x00}, // 0x22 '"'
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    {0x10,0x08,0x08,0x10,0x08,0x00}, // 0x7E '~'
};

// ---------------------------------------------------------------------------
// Private bus + panel init helper, shared by oled_init() and oled_face_init().
// ---------------------------------------------------------------------------

static esp_err_t init_panel(oled_state_t *st, int sda_gpio, int scl_gpio,
                            uint8_t addr, const char *label)
{
    if (st->initialized) return ESP_OK;

    i2c_master_bus_config_t bus_cfg = {
        .clk_source = I2C_CLK_SRC_DEFAULT,
        .sda_io_num = sda_gpio,
        .scl_io_num = scl_gpio,
        .i2c_port = -1,                 // auto-pick a free port
        .glitch_ignore_cnt = 7,
        .flags.enable_internal_pullup = true,
    };
    esp_err_t err = i2c_new_master_bus(&bus_cfg, &st->bus);
    if (err != ESP_OK) {
        ESP_LOGE(TAG, "[%s] i2c_new_master_bus failed: %s", label,
                 esp_err_to_name(err));
        return err;
    }

    esp_lcd_panel_io_i2c_config_t io_cfg = {
        .dev_addr = addr,
        .scl_speed_hz = OLED_I2C_FREQ_HZ,
        .control_phase_bytes = 1,
        .dc_bit_offset = 6,
        .lcd_cmd_bits = 8,
        .lcd_param_bits = 8,
    };
    err = esp_lcd_new_panel_io_i2c(st->bus, &io_cfg, &st->io);
    if (err != ESP_OK) {
        ESP_LOGE(TAG, "[%s] esp_lcd_new_panel_io_i2c failed: %s", label,
                 esp_err_to_name(err));
        return err;
    }

    esp_lcd_panel_ssd1306_config_t ssd_cfg = { .height = OLED_H };
    esp_lcd_panel_dev_config_t panel_cfg = {
        .bits_per_pixel = 1,
        .reset_gpio_num = -1,
        .vendor_config = &ssd_cfg,
    };
    err = esp_lcd_new_panel_ssd1306(st->io, &panel_cfg, &st->panel);
    if (err != ESP_OK) {
        ESP_LOGE(TAG, "[%s] esp_lcd_new_panel_ssd1306 failed: %s", label,
                 esp_err_to_name(err));
        return err;
    }
    // The reset/init/disp_on commands actually talk to the chip over I²C.
    // If the panel is unwired or unpowered, these NACK and we want to
    // surface that as an error rather than aborting the whole device.
    err = esp_lcd_panel_reset(st->panel);
    if (err != ESP_OK) {
        ESP_LOGE(TAG, "[%s] panel_reset failed: %s — skipping",
                 label, esp_err_to_name(err));
        return err;
    }
    err = esp_lcd_panel_init(st->panel);
    if (err != ESP_OK) {
        ESP_LOGE(TAG, "[%s] panel_init failed: %s — skipping",
                 label, esp_err_to_name(err));
        return err;
    }
    err = esp_lcd_panel_disp_on_off(st->panel, true);
    if (err != ESP_OK) {
        ESP_LOGE(TAG, "[%s] panel_disp_on failed: %s — skipping",
                 label, esp_err_to_name(err));
        return err;
    }

    memset(st->fb, 0, sizeof st->fb);
    st->initialized = true;
    ESP_LOGI(TAG, "[%s] SSD1306 init OK at SDA=%d SCL=%d addr=0x%02x",
             label, sda_gpio, scl_gpio, addr);
    return ESP_OK;
}

// ---------------------------------------------------------------------------
// MAIN panel — public API (unchanged from M1-M6).
// ---------------------------------------------------------------------------

esp_err_t oled_init(void)
{
    return init_panel(&s_main, MAIN_SDA_GPIO, MAIN_SCL_GPIO, OLED_I2C_ADDR, "main");
}

void oled_clear(void)
{
    memset(s_main.fb, 0, sizeof s_main.fb);
}

void oled_draw_text(int line, const char *text)
{
    if (line < 0 || line >= OLED_LINES) return;
    uint8_t *row = &s_main.fb[line * OLED_W];
    int col = 0;
    for (const char *p = text; *p && col + 6 <= OLED_W; ++p) {
        unsigned char c = (unsigned char)*p;
        if (c < 0x20 || c > 0x7E) c = ' ';
        const uint8_t *glyph = font6x8[c - 0x20];
        for (int i = 0; i < 6; ++i) row[col + i] = glyph[i];
        col += 6;
    }
    while (col < OLED_W) row[col++] = 0x00;
}

void oled_flush(void)
{
    if (!s_main.initialized) return;
    esp_lcd_panel_draw_bitmap(s_main.panel, 0, 0, OLED_W, OLED_H, s_main.fb);
}

// ---------------------------------------------------------------------------
// FACE panel — public API (new for the cat-face OLED).
// ---------------------------------------------------------------------------

esp_err_t oled_face_init(void)
{
    return init_panel(&s_face, FACE_SDA_GPIO, FACE_SCL_GPIO, OLED_I2C_ADDR, "face");
}

void oled_face_clear(void)
{
    memset(s_face.fb, 0, sizeof s_face.fb);
}

void oled_face_fill(uint8_t pattern)
{
    memset(s_face.fb, pattern, sizeof s_face.fb);
}

void oled_face_draw_bitmap(const uint8_t *bytes)
{
    if (!bytes) return;
    memcpy(s_face.fb, bytes, OLED_FB_BYTES);
}

void oled_face_flush(void)
{
    if (!s_face.initialized) return;
    esp_lcd_panel_draw_bitmap(s_face.panel, 0, 0, OLED_W, OLED_H, s_face.fb);
}
